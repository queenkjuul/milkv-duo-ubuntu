## milkv-linux/milkv-duo256m.its
```
/dts-v1/;

/ {
    description = "Milk-V Duo 256M - Linux 7.0.x";
    #address-cells = <1>;

    images {
        kernel-1 {
            description = "Linux kernel";
            data = /incbin/("./linux/arch/riscv/boot/Image");
            type = "kernel";
            arch = "riscv";
            os = "linux";
            compression = "none";
            load = <0x80200000>;
            entry = <0x80200000>;
        };
        fdt-1 {
            description = "Device Tree";
            data = /incbin/("./linux/arch/riscv/boot/dts/sophgo/sg2002-milkv-duo-256m.dtb");
            type = "flat_dt";
            arch = "riscv";
            compression = "none";
            load = <0x81780000>;
        };
    };

    configurations {
        config-sg2002_milkv_duo256m_musl_riscv64_sd {
            description = "Milk-V Duo 256M upstream kernel (qkj1)";
            kernel = "kernel-1";
            fdt = "fdt-1";
        };
    };
};
```
